## drivers/gnss/Kconfig.gnss_m8
```kconfig
#
# Copyright (c) 2023 HARDWARIO a.s.
#
# SPDX-License-Identifier: LicenseRef-HARDWARIO-5-Clause
#

config GNSS_M8
	bool "u-blox M8 GNSS Receiver Driver"
	depends on GNSS
	depends on GPIO
	depends on I2C

if GNSS_M8

config GNSS_M8_INIT_PRIORITY
	int "GNSS M8 init priority"
	default 80
	help
	  GNSS M8 device driver initialization priority.
	  Must be higher than I2C bus and any GPIO expander
	  used for enable pins.

module = GNSS_M8
module-str = gnss_m8
source "subsys/logging/Kconfig.template.log_config"

endif # GNSS_M8
```

## subsys/ctr_lte_v2/Kconfig
```kconfig
#
# Copyright (c) 2023 HARDWARIO a.s.
#
# SPDX-License-Identifier: LicenseRef-HARDWARIO-5-Clause
#

config CTR_LTE_V2
	bool "CTR_LTE_V2"
	select CTR_LTE_LINK if !ZTEST
	select CTR_RFMUX if !ZTEST
	select CTR_INFO if !ZTEST
	select CTR_CONFIG
	select CTR_UTIL
	select PM_DEVICE
	select RING_BUFFER

if CTR_LTE_V2

choice
	prompt "CTR_LTE_V2_CONFIG_ANTENNA"
	default CTR_LTE_V2_CONFIG_ANTENNA_INT

config CTR_LTE_V2_CONFIG_ANTENNA_INT
	bool "CTR_LTE_V2_CONFIG_ANTENNA_INT"

config CTR_LTE_V2_CONFIG_ANTENNA_EXT
	bool "CTR_LTE_V2_CONFIG_ANTENNA_EXT"
endchoice

config CTR_LTE_V2_CONFIG_ANTENNA
	int "CTR_LTE_V2_CONFIG_ANTENNA"
	default 0 if CTR_LTE_V2_CONFIG_ANTENNA_INT
	default 1 if CTR_LTE_V2_CONFIG_ANTENNA_EXT

config CTR_LTE_V2_DEFAULT_MODE
	string "CTR_LTE_V2_DEFAULT_MODE"
	default "nb-iot"

config CTR_LTE_V2_DEFAULT_BANDS
	string "CTR_LTE_V2_DEFAULT_BANDS"
	default ""
	help
		original value: "2,4,5,8,12,13,17,18,19,20,25,26,28,66"

config CTR_LTE_V2_DEFAULT_NETWORK
	string "CTR_LTE_V2_DEFAULT_NETWORK"
	default ""

config CTR_LTE_V2_DEFAULT_APN
	string "CTR_LTE_V2_DEFAULT_APN"
	default ""
	help
		original value: "hardwario"

config CTR_LTE_V2_DEFAULT_ADDR
	string "CTR_LTE_V2_DEFAULT_ADDR"
	default "192.168.192.4"

config CTR_LTE_V2_PORT
	int "CTR_LTE_V2_PORT"
	default 5003

config CTR_LTE_V2_INIT_PRIORITY
	int "CTR_LTE_V2_INIT_PRIORITY"
	default 99

config CTR_LTE_V2_THREAD_STACK_SIZE
	int "CTR_LTE_V2_THREAD_STACK_SIZE"
	default 4096

config CTR_LTE_V2_THREAD_PRIORITY
	int "CTR_LTE_V2_THREAD_PRIORITY"
	default 10

config CTR_LTE_V2_GNSS
	bool "CTR_LTE_V2_GNSS"
	default y

choice CTR_LTE_V2_POWER_MODE
	prompt "LTE Power Saving Mode"
	default CTR_LTE_V2_MODE_PSM
	help
	  Select the power saving mode for LTE connectivity.
	  PSM (Power Saving Mode) provides maximum battery life with deep sleep.
	  eDRX (extended Discontinuous Reception) provides lower latency with
	  periodic reachability windows.
	  Hybrid mode enables both PSM and eDRX together.

config CTR_LTE_V2_MODE_PSM
	bool "Power Saving Mode (PSM)"
	help
	  Use PSM for maximum battery life with infrequent transmissions.
	  Device enters deep sleep between transmissions.
	  Best for sensors sending data hourly or less frequently.

config CTR_LTE_V2_MODE_EDRX
	bool "Extended Discontinuous Reception (eDRX)"
	help
	  Use eDRX for lower latency with moderate power consumption.
	  Device remains reachable with configurable paging cycles.
	  Best for devices requiring faster downlink response (< 2 minutes).

config CTR_LTE_V2_MODE_HYBRID
	bool "Hybrid PSM + eDRX"
	help
	  Use both PSM and eDRX for balanced power and responsiveness.
	  eDRX provides periodic reachability windows while PSM enables
	  deep sleep between eDRX cycles when no communication is needed.

endchoice

config CTR_LTE_V2_EDRX_CYCLE
	string "eDRX Cycle Value"
	default "0100"
	depends on CTR_LTE_V2_MODE_EDRX || CTR_LTE_V2_MODE_HYBRID
	help
	  eDRX cycle value as a 4-bit binary string for LTE-M:
	    "0000" = 5.12s   (very low latency, high power)
	    "0001" = 10.24s  (low latency)
	    "0010" = 20.48s  (good balance)
	    "0011" = 40.96s  (moderate latency)
	    "0100" = 81.92s  (recommended for 60s polling)
	    "0101" = 163.84s (lower power, higher latency)
	    "0110" = 327.68s (very low power)
	    "0111" = 655.36s (maximum cycle for LTE-M)
	  For 60-second locker polling, use "0100" (81.92s) or "0011" (40.96s).

config HEAP_MEM_POOL_SIZE
	int "HEAP_MEM_POOL_SIZE"
	default 8192

module = CTR_LTE_V2
module-str = CHESTER LTE Subsystem
source "subsys/logging/Kconfig.template.log_config"

endif # CTR_LTE_V2
```
